# ATmega2564RFR2 device description
Architecture: AVR8; Family: megaAVR
Parameters: SUPPORTS_EEPROM_ERASE=1
Programming and debug interfaces: ISP, HVPP, JTAG
Registers are 8-bit, access not given, no defined reset value unless marked. A register's access mark holds for its fields unless they carry their own. Offsets are from the block's base; lines under a group give offsets from that group; [hi:lo] are bit positions; {n}, {i} and the like mark numbered series; 'fields as' and 'values as' point back to an identical list; <NAME> marks a mode.

## Ordering variants
ATmega2564RFR2-ZU, ATmega2564RFR2-ZUR: VQFN48, up to 16 MHz, -40 to 85 C, 1.8 to 3.6 V
ATmega2564RFR2-ZF, ATmega2564RFR2-ZFR: VQFN48, up to 16 MHz, -40 to 125 C, 1.8 to 3.6 V

## Memory
prog space: start 0x0000 size 0x40000, little endian
  0x0000 FLASH size 0x40000 flash, rw, executable, page 0x100
  0x3fc00 BOOT_SECTION_1 size 0x0400 flash, rw, executable, page 0x100
  0x3f800 BOOT_SECTION_2 size 0x0800 flash, rw, executable, page 0x100
  0x3f000 BOOT_SECTION_3 size 0x1000 flash, rw, executable, page 0x100
  0x3e000 BOOT_SECTION_4 size 0x2000 flash, rw, executable, page 0x100
signatures space: start 0 size 3, little endian
  0 SIGNATURES size 3 signatures, ro
fuses space: start 0 size 0x0003, little endian
  0 FUSES size 0x0003 fuses, rw
lockbits space: start 0 size 0x0001, little endian
  0 LOCKBITS size 0x0001 lockbits, rw
user_signatures space: start 0x0100 size 0x0300, little endian
  0x0100 USER_SIGNATURES size 0x0300 user_signatures, rw, page 0x100
data space: start 0x0000 size 0x8200, little endian
  0x0000 REGISTERS size 0x0020 regs
  0x0020 MAPPED_IO size 0x01e0 io
  0x0200 IRAM size 0x8000 ram
eeprom space: start 0x0000 size 0x2000, little endian
  0x0000 EEPROM size 0x2000 eeprom, rw, page 0x08
io space: start 0x00 size 0x40, little endian
osccal space: start 0 size 1, little endian
  0 OSCCAL size 1 osccal, ro

## Peripheral instances (address, pins/pin function, parameters)
AC at 0x00 — Analog Comparator
USART0 at 0x00 — USART
USART1 at 0x00 — USART
TWI at 0x00 — Two Wire Serial Interface
SPI at 0x00 — Serial Peripheral Interface
USART0_SPI at 0x00 — Serial Peripheral Interface
USART1_SPI at 0x00 — Serial Peripheral Interface
PORTA at 0x00 — I/O Port
PORTB at 0x00 — I/O Port
PORTC at 0x00 — I/O Port
PORTD at 0x00 — I/O Port
PORTE at 0x00 — I/O Port
PORTF at 0x00 — I/O Port
PORTG at 0x00 — I/O Port
TC0 at 0x00 — Timer/Counter, 8-bit
TC2 at 0x00 — Timer/Counter, 8-bit Async
WDT at 0x00 — Watchdog Timer
TC{n} at 0x00 (n=3..5) — Timer/Counter, 16-bit
TC1 at 0x00 — Timer/Counter, 16-bit
TRX24 at 0x00 — Low-Power 2.4 GHz Transceiver
SYMCNT at 0x00 — MAC Symbol Counter
EEPROM at 0x00
JTAG at 0x00 — JTAG Interface
EXINT at 0x00 — External Interrupts
ADC at 0x00 — Analog-to-Digital Converter
BOOT_LOAD at 0x00 — Bootloader
CPU at 0x00 — CPU Registers
  parameters: CORE_VERSION=V3
FLASH at 0x00 — FLASH Controller
PWRCTRL at 0x00 — Power Controller
FUSE at 0 in fuses — Fuses
LOCKBIT at 0 in lockbits — Lockbits

## Interrupts
0 RESET — External Pin,Power-on Reset,Brown-out Reset,Watchdog Reset,and JTAG AVR Reset. See Datasheet.
{n+1} INT{n} (n=0..7) — External Interrupt Request {n}
9 PCINT0 — Pin Change Interrupt Request 0
10 PCINT1 — Pin Change Interrupt Request 1
11 PCINT2 — Pin Change Interrupt Request 2
12 WDT — Watchdog Time-out Interrupt
13 TIMER2_COMPA — Timer/Counter2 Compare Match A
14 TIMER2_COMPB — Timer/Counter2 Compare Match B
15 TIMER2_OVF — Timer/Counter2 Overflow
16 TIMER1_CAPT — Timer/Counter1 Capture Event
17 TIMER1_COMPA — Timer/Counter1 Compare Match A
18 TIMER1_COMPB — Timer/Counter1 Compare Match B
19 TIMER1_COMPC — Timer/Counter1 Compare Match C
20 TIMER1_OVF — Timer/Counter1 Overflow
21 TIMER0_COMPA — Timer/Counter0 Compare Match A
22 TIMER0_COMPB — Timer/Counter0 Compare Match B
23 TIMER0_OVF — Timer/Counter0 Overflow
24 SPI_STC — SPI Serial Transfer Complete
25 USART0_RX — USART0, Rx Complete
26 USART0_UDRE — USART0 Data register Empty
27 USART0_TX — USART0, Tx Complete
28 ANALOG_COMP — Analog Comparator
29 ADC — ADC Conversion Complete
30 EE_READY — EEPROM Ready
31 TIMER3_CAPT — Timer/Counter3 Capture Event
32 TIMER3_COMPA — Timer/Counter3 Compare Match A
33 TIMER3_COMPB — Timer/Counter3 Compare Match B
34 TIMER3_COMPC — Timer/Counter3 Compare Match C
35 TIMER3_OVF — Timer/Counter3 Overflow
36 USART1_RX — USART1, Rx Complete
37 USART1_UDRE — USART1 Data register Empty
38 USART1_TX — USART1, Tx Complete
39 TWI — 2-wire Serial Interface
40 SPM_READY — Store Program Memory Read
41 TIMER4_CAPT — Timer/Counter4 Capture Event
42 TIMER4_COMPA — Timer/Counter4 Compare Match A
43 TIMER4_COMPB — Timer/Counter4 Compare Match B
44 TIMER4_COMPC — Timer/Counter4 Compare Match C
45 TIMER4_OVF — Timer/Counter4 Overflow
46 TIMER5_CAPT — Timer/Counter5 Capture Event
47 TIMER5_COMPA — Timer/Counter5 Compare Match A
48 TIMER5_COMPB — Timer/Counter5 Compare Match B
49 TIMER5_COMPC — Timer/Counter5 Compare Match C
50 TIMER5_OVF — Timer/Counter5 Overflow
57 TRX24_PLL_LOCK — TRX24 - PLL lock interrupt
58 TRX24_PLL_UNLOCK — TRX24 - PLL unlock interrupt
59 TRX24_RX_START — TRX24 - Receive start interrupt
60 TRX24_RX_END — TRX24 - RX_END interrupt
61 TRX24_CCA_ED_DONE — TRX24 - CCA/ED done interrupt
62 TRX24_XAH_AMI
63 TRX24_TX_END — TRX24 - TX_END interrupt
64 TRX24_AWAKE — TRX24 AWAKE - tranceiver is reaching state TRX_OFF
65 SCNT_CMP1 — Symbol counter - compare match 1 interrupt
66 SCNT_CMP2 — Symbol counter - compare match 2 interrupt
67 SCNT_CMP3 — Symbol counter - compare match 3 interrupt
68 SCNT_OVFL — Symbol counter - overflow interrupt
69 SCNT_BACKOFF — Symbol counter - backoff interrupt
70 AES_READY — AES engine ready interrupt
71 BAT_LOW — Battery monitor indicates supply voltage below threshold
72 TRX24_TX_START — TRX24 TX start interrupt
73 TRX24_AMI0 — Address match interrupt of address filter 0
74 TRX24_AMI1 — Address match interrupt of address filter 1
75 TRX24_AMI2 — Address match interrupt of address filter 2
76 TRX24_AMI3 — Address match interrupt of address filter 3

## Properties
SIGNATURES: JTAGID=0x0A80303F, SIGNATURE0=0x1e, SIGNATURE1=0xa8, SIGNATURE2=0x03
OCD: OCD_REVISION=4, OCD_DATAREG=0x31, PROGBASE=0x0000
