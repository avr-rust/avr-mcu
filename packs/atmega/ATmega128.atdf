# ATmega128 device description
Architecture: AVR8; Family: megaAVR
Programming and debug interfaces: ISP, HVPP, JTAG
Registers are 8-bit, access not given, no defined reset value unless marked. A register's access mark holds for its fields unless they carry their own. Offsets are from the block's base; lines under a group give offsets from that group; [hi:lo] are bit positions; {n}, {i} and the like mark numbered series; 'fields as' and 'values as' point back to an identical list; <NAME> marks a mode.

## Ordering variants
ATmega128L-8AU: TQFP64, pinout TQFPQFN64, up to 8 MHz, -40 to 85 C, 2.7 to 5.5 V
ATmega128L-8MU: QFN64, pinout TQFPQFN64, up to 8 MHz, -40 to 85 C, 2.7 to 5.5 V
ATmega128-16AU: TQFP64, pinout TQFPQFN64, up to 16 MHz, -40 to 85 C, 4.5 to 5.5 V
ATmega128-16MU: QFN64, pinout TQFPQFN64, up to 16 MHz, -40 to 85 C, 4.5 to 5.5 V
ATmega128L-8AN: TQFP64, pinout TQFPQFN64, up to 8 MHz, -40 to 105 C, 3.0 to 5.5 V
ATmega128L-8MN: QFN64, pinout TQFPQFN64, up to 8 MHz, -40 to 105 C, 3.0 to 5.5 V
ATmega128-16AN: TQFP64, pinout TQFPQFN64, up to 16 MHz, -40 to 105 C, 4.5 to 5.5 V
ATmega128-16MN: QFN64, pinout TQFPQFN64, up to 16 MHz, -40 to 105 C, 4.5 to 5.5 V

## Memory
prog space: start 0x0000 size 0x20000, little endian
  0x0000 FLASH size 0x20000 flash, rw, executable, page 0x100
  0x1fc00 BOOT_SECTION_1 size 0x0400 flash, rw, executable, page 0x100
  0x1f800 BOOT_SECTION_2 size 0x0800 flash, rw, executable, page 0x100
  0x1f000 BOOT_SECTION_3 size 0x1000 flash, rw, executable, page 0x100
  0x1e000 BOOT_SECTION_4 size 0x2000 flash, rw, executable, page 0x100
signatures space: start 0 size 3, little endian
  0 SIGNATURES size 3 signatures, ro
fuses space: start 0 size 0x0003, little endian
  0 FUSES size 0x0003 fuses, rw
lockbits space: start 0 size 0x0001, little endian
  0 LOCKBITS size 0x0001 lockbits, rw
data space: start 0x0000 size 0x10000, little endian
  0x0000 REGISTERS size 0x0020 regs
  0x0020 MAPPED_IO size 0x00e0 io
  0x0100 IRAM size 0x1000 ram
  0x1100 XRAM size 0xef00 ram, external
eeprom space: start 0x0000 size 0x1000, little endian
  0x0000 EEPROM size 0x1000 eeprom, rw, page 0x08
io space: start 0x00 size 0x40, little endian
osccal space: start 0 size 4, little endian
  0 OSCCAL size 4 osccal, ro

## Peripheral instances (address, pins/pin function, parameters)
AC at 0x00 — Analog Comparator
  pins: AIN1 PE3; AIN0 PE2
SPI at 0x00 — Serial Peripheral Interface
  pins: MISO PB3; MOSI PB2; SCK PB1; SS PB0
TWI at 0x00 — Two Wire Serial Interface
  pins: SDA PD1; SCL PD0
USART0 at 0x00 — USART
  pins: XCK PE2; TXD PE1; RXD PE0
USART1 at 0x00 — USART
  pins: XCK PD5; TXD PD3; RXD PD2
CPU at 0x00 — CPU Registers
  parameters: CORE_VERSION=V2E
BOOT_LOAD at 0x00 — Bootloader
JTAG at 0x00 — JTAG Interface
  pins: TDI PF7; TDO PF6; TMS PF5; TCK PF4
MISC at 0x00 — Other Registers
  pins: AD{n} PA{n} (n=0..7); A{n} PC{n-8} (n=8..15); PDO PE1; PDI PE0; ALE PG2; RD PG1; WR PG0
EXINT at 0x00 — External Interrupts
  pins: INT7 PE7; INT6 PE6; INT5 PE5; INT4 PE4; INT3 PD3; INT2 PD2; INT1 PD1; INT0 PD0
EEPROM at 0x00
PORTA at 0x00 — I/O Port
  pins: P{n} PA{n} (n=0..7)
PORTB at 0x00 — I/O Port
  pins: P{n} PB{n} (n=0..7)
PORTC at 0x00 — I/O Port
  pins: P{n} PC{n} (n=0..7)
PORTD at 0x00 — I/O Port
  pins: P{n} PD{n} (n=0..7)
PORTE at 0x00 — I/O Port
  pins: P{n} PE{n} (n=0..7)
PORTF at 0x00 — I/O Port
  pins: P{n} PF{n} (n=0..7)
PORTG at 0x00 — I/O Port
  pins: P0 PG0; P1 PG1; P2 PG2; P3 PG3; P4 PG4
TC0 at 0x00 — Timer/Counter, 8-bit Async
  pins: OC PB4; TOSC1 PG4; TOSC2 PG3
TC1 at 0x00 — Timer/Counter, 16-bit
  pins: OCC PB7; OCB PB6; OCA PB5; T PD6; ICP PD4
TC3 at 0x00 — Timer/Counter, 16-bit
  pins: ICP PE7; T PE6; OCC PE5; OCB PE4; OCA PE3
TC2 at 0x00 — Timer/Counter, 8-bit
  pins: OC PB7; T PD7
WDT at 0x00 — Watchdog Timer
ADC at 0x00 — Analog-to-Digital Converter
  pins: ADC{n} PF{n} (n=0..7)
FUSE at 0 in fuses — Fuses
LOCKBIT at 0 in lockbits — Lockbits

## Interrupts
0 RESET — External Pin, Power-on Reset, Brown-out Reset, Watchdog Reset and JTAG AVR Reset
{n+1} INT{n} (n=0..7) — External Interrupt Request {n}
9 TIMER2_COMP — Timer/Counter2 Compare Match
10 TIMER2_OVF — Timer/Counter2 Overflow
11 TIMER1_CAPT — Timer/Counter1 Capture Event
12 TIMER1_COMPA — Timer/Counter1 Compare Match A
13 TIMER1_COMPB — Timer/Counter Compare Match B
14 TIMER1_OVF — Timer/Counter1 Overflow
15 TIMER0_COMP — Timer/Counter0 Compare Match
16 TIMER0_OVF — Timer/Counter0 Overflow
17 SPI_STC — SPI Serial Transfer Complete
18 USART0_RX — USART0, Rx Complete
19 USART0_UDRE — USART0 Data Register Empty
20 USART0_TX — USART0, Tx Complete
21 ADC — ADC Conversion Complete
22 EE_READY — EEPROM Ready
23 ANALOG_COMP — Analog Comparator
24 TIMER1_COMPC — Timer/Counter1 Compare Match C
25 TIMER3_CAPT — Timer/Counter3 Capture Event
26 TIMER3_COMPA — Timer/Counter3 Compare Match A
27 TIMER3_COMPB — Timer/Counter3 Compare Match B
28 TIMER3_COMPC — Timer/Counter3 Compare Match C
29 TIMER3_OVF — Timer/Counter3 Overflow
30 USART1_RX — USART1, Rx Complete
31 USART1_UDRE — USART1, Data Register Empty
32 USART1_TX — USART1, Tx Complete
33 TWI — 2-wire Serial Interface
34 SPM_READY — Store Program Memory Read

## Properties
SIGNATURES: JTAGID=0x0970203F, SIGNATURE0=0x1e, SIGNATURE1=0x97, SIGNATURE2=0x02
OCD: OCD_REVISION=1, OCD_DATAREG=0x22, PROGBASE=0x0000

## Pinouts (pin number, pad)
TQFPQFN64: 1 PEN, 2 PE0, 3 PE1, 4 PE2, 5 PE3, 6 PE4, 7 PE5, 8 PE6, 9 PE7, 10 PB0, 11 PB1, 12 PB2, 13 PB3, 14 PB4, 15 PB5, 16 PB6, 17 PB7, 18 PG3, 19 PG4, 20 RESET, 21 VCC, 22 GND, 23 XTAL2, 24 XTAL1, 25 PD0, 26 PD1, 27 PD2, 28 PD3, 29 PD4, 30 PD5, 31 PD6, 32 PD7, 33 PG0, 34 PG1, 35 PC0, 36 PC1, 37 PC2, 38 PC3, 39 PC4, 40 PC5, 41 PC6, 42 PC7, 43 PG2, 44 PA7, 45 PA6, 46 PA5, 47 PA4, 48 PA3, 49 PA2, 50 PA1, 51 PA0, 52 VCC, 53 GND, 54 PF7, 55 PF6, 56 PF5, 57 PF4, 58 PF3, 59 PF2, 60 PF1, 61 PF0, 62 AREF, 63 GND, 64 AVCC
