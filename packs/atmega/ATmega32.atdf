# ATmega32 device description
Architecture: AVR8; Family: megaAVR
Programming and debug interfaces: ISP, HVPP, JTAG
Registers are 8-bit, access not given, no defined reset value unless marked. A register's access mark holds for its fields unless they carry their own. Offsets are from the block's base; lines under a group give offsets from that group; [hi:lo] are bit positions; {n}, {i} and the like mark numbered series; 'fields as' and 'values as' point back to an identical list; <NAME> marks a mode.

## Ordering variants
ATmega32L-8AU: TQFP44, pinout TQFPQFN44, up to 8 MHz, -40 to 85 C, 2.7 to 5.5 V
ATmega32L-8PU: PDIP40, up to 8 MHz, -40 to 85 C, 2.7 to 5.5 V
ATmega32L-8MU: QFN44, pinout TQFPQFN44, up to 8 MHz, -40 to 85 C, 2.7 to 5.5 V
ATmega32-16AU: TQFP44, pinout TQFPQFN44, up to 16 MHz, -40 to 85 C, 4.5 to 5.5 V
ATmega32-16PU: PDIP40, up to 16 MHz, -40 to 85 C, 4.5 to 5.5 V
ATmega32-16MU: QFN44, pinout TQFPQFN44, up to 16 MHz, -40 to 85 C, 4.5 to 5.5 V

## Memory
prog space: start 0x0000 size 0x8000, little endian
  0x0000 FLASH size 0x8000 flash, rw, executable, page 0x80
  0x7e00 BOOT_SECTION_1 size 0x0200 flash, rw, executable, page 0x80
  0x7c00 BOOT_SECTION_2 size 0x0400 flash, rw, executable, page 0x80
  0x7800 BOOT_SECTION_3 size 0x0800 flash, rw, executable, page 0x80
  0x7000 BOOT_SECTION_4 size 0x1000 flash, rw, executable, page 0x80
signatures space: start 0 size 3, little endian
  0 SIGNATURES size 3 signatures, ro
fuses space: start 0 size 0x0002, little endian
  0 FUSES size 0x0002 fuses, rw
lockbits space: start 0 size 0x0001, little endian
  0 LOCKBITS size 0x0001 lockbits, rw
data space: start 0x0000 size 0x0860, little endian
  0x0000 REGISTERS size 0x0020 regs
  0x0020 MAPPED_IO size 0x0040 io
  0x0060 IRAM size 0x0800 ram
eeprom space: start 0x0000 size 0x0400, little endian
  0x0000 EEPROM size 0x0400 eeprom, rw, page 0x04
io space: start 0x00 size 0x40, little endian
osccal space: start 0 size 4, little endian
  0 OSCCAL size 4 osccal, ro

## Peripheral instances (address, pins/pin function, parameters)
EEPROM at 0x00
WDT at 0x00 — Watchdog Timer
EXINT at 0x00 — External Interrupts
  pins: INT2 PB2; INT1 PD3; INT0 PD2
TC0 at 0x00 — Timer/Counter, 8-bit
  pins: OC PB3; T PB0
TC2 at 0x00 — Timer/Counter, 8-bit Async
  pins: TOSC2 PC7; TOSC1 PC6; OC PD7
TC1 at 0x00 — Timer/Counter, 16-bit
  pins: T PB1; ICP PD6; OCA PD5; OCB PD4
SPI at 0x00 — Serial Peripheral Interface
  pins: SCK PB7; MISO PB6; MOSI PB5; SS PB4
USART at 0x00
  pins: XCK PB0; TXD PD1; RXD PD0
AC at 0x00 — Analog Comparator
  pins: AIN1 PB3; AIN0 PB2
ADC at 0x00 — Analog-to-Digital Converter
  pins: ADC{n} PA{n} (n=0..7)
PORTA at 0x00 — I/O Port
  pins: P{n} PA{n} (n=0..7)
PORTB at 0x00 — I/O Port
  pins: P{n} PB{n} (n=0..7)
PORTC at 0x00 — I/O Port
  pins: P{n} PC{n} (n=0..7)
PORTD at 0x00 — I/O Port
  pins: P{n} PD{n} (n=0..7)
CPU at 0x00 — CPU Registers
  parameters: CORE_VERSION=V2E
BOOT_LOAD at 0x00 — Bootloader
TWI at 0x00 — Two Wire Serial Interface
  pins: SDA PC1; SCL PC0
FUSE at 0 in fuses — Fuses
LOCKBIT at 0 in lockbits — Lockbits
JTAG at 0x00 — JTAG Interface
  pins: TDI PC5; TDO PC4; TMS PC3; TCK PC2

## Interrupts
0 RESET — External Pin, Power-on Reset, Brown-out Reset and Watchdog Reset
1 INT0 — External Interrupt Request 0
2 INT1 — External Interrupt Request 1
3 INT2 — External Interrupt Request 2
4 TIMER2_COMP — Timer/Counter2 Compare Match
5 TIMER2_OVF — Timer/Counter2 Overflow
6 TIMER1_CAPT — Timer/Counter1 Capture Event
7 TIMER1_COMPA — Timer/Counter1 Compare Match A
8 TIMER1_COMPB — Timer/Counter1 Compare Match B
9 TIMER1_OVF — Timer/Counter1 Overflow
10 TIMER0_COMP — Timer/Counter0 Compare Match
11 TIMER0_OVF — Timer/Counter0 Overflow
12 SPI_STC — Serial Transfer Complete
13 USART_RXC — USART, Rx Complete
14 USART_UDRE — USART Data Register Empty
15 USART_TXC — USART, Tx Complete
16 ADC — ADC Conversion Complete
17 EE_RDY — EEPROM Ready
18 ANA_COMP — Analog Comparator
19 TWI — 2-wire Serial Interface
20 SPM_RDY — Store Program Memory Ready

## Properties
SIGNATURES: JTAGID=0x0950203F, SIGNATURE0=0x1e, SIGNATURE1=0x95, SIGNATURE2=0x02
OCD: OCD_REVISION=2, OCD_DATAREG=0x31, PROGBASE=0x0000

## Pinouts (pin number, pad)
TQFPQFN44: 1 PB5, 2 PB6, 3 PB7, 4 RESET, 5 VCC, 6 GND, 7 XTAL2, 8 XTAL1, 9 PD0, 10 PD1, 11 PD2, 12 PD3, 13 PD4, 14 PD5, 15 PD6, 16 PD7, 17 VCC, 18 GND, 19 PC0, 20 PC1, 21 PC2, 22 PC3, 23 PC4, 24 PC5, 25 PC6, 26 PC7, 27 AVCC, 28 GND, 29 AREF, 30 PA7, 31 PA6, 32 PA5, 33 PA4, 34 PA3, 35 PA2, 36 PA1, 37 PA0, 38 VCC, 39 GND, 40 PB0, 41 PB1, 42 PB2, 43 PB3, 44 PB4
PDIP40: 1 PB0, 2 PB1, 3 PB2, 4 PB3, 5 PB4, 6 PB5, 7 PB6, 8 PB7, 9 RESET, 10 VCC, 11 GND, 12 XTAL2, 13 XTAL1, 14 PD0, 15 PD1, 16 PD2, 17 PD3, 18 PD4, 19 PD5, 20 PD6, 21 PD7, 22 PC0, 23 PC1, 24 PC2, 25 PC3, 26 PC4, 27 PC5, 28 PC6, 29 PC7, 30 AVCC, 31 GND, 32 AREF, 33 PA7, 34 PA6, 35 PA5, 36 PA4, 37 PA3, 38 PA2, 39 PA1, 40 PA0
