# AT90USB1287 device description
Architecture: AVR8; Family: megaAVR
Programming and debug interfaces: ISP, HVPP, JTAG
Registers are 8-bit, access not given, no defined reset value unless marked. A register's access mark holds for its fields unless they carry their own. Offsets are from the block's base; lines under a group give offsets from that group; [hi:lo] are bit positions; {n}, {i} and the like mark numbered series; 'fields as' and 'values as' point back to an identical list; <NAME> marks a mode.

## Ordering variants
standard: 2.2 to 5.5 V

## Memory
prog space: start 0x0000 size 0x20000, little endian
  0x0000 FLASH size 0x20000 flash, rw, executable, page 0x100
  0x1fc00 BOOT_SECTION_1 size 0x0400 flash, rw, executable, page 0x100
  0x1f800 BOOT_SECTION_2 size 0x0800 flash, rw, executable, page 0x100
  0x1f000 BOOT_SECTION_3 size 0x1000 flash, rw, executable, page 0x100
  0x1e000 BOOT_SECTION_4 size 0x2000 flash, rw, executable, page 0x100
signatures space: start 0 size 3, little endian
  0 SIGNATURES size 3 signatures, ro
fuses space: start 0 size 0x0003, little endian
  0 FUSES size 0x0003 fuses, rw
lockbits space: start 0 size 0x0001, little endian
  0 LOCKBITS size 0x0001 lockbits, rw
data space: start 0x0000 size 0x10000, little endian
  0x0000 REGISTERS size 0x0020 regs
  0x0020 MAPPED_IO size 0x00e0 io
  0x0100 IRAM size 0x2000 ram
  0x2200 XRAM size 0xde00 ram, external
eeprom space: start 0x0000 size 0x1000, little endian
  0x0000 EEPROM size 0x1000 eeprom, rw, page 0x08
io space: start 0x00 size 0x40, little endian
osccal space: start 0 size 1, little endian
  0 OSCCAL size 1 osccal, ro

## Peripheral instances (address, pins/pin function, parameters)
WDT at 0x00 — Watchdog Timer
PORTA at 0x00 — I/O Port
PORTB at 0x00 — I/O Port
PORTC at 0x00 — I/O Port
PORTD at 0x00 — I/O Port
PORTE at 0x00 — I/O Port
PORTF at 0x00 — I/O Port
CPU at 0x00 — CPU Registers
  parameters: CORE_VERSION=V3
TWI at 0x00 — Two Wire Serial Interface
SPI at 0x00 — Serial Peripheral Interface
USART1 at 0x00 — USART
USB_DEVICE at 0x00 — USB Device Registers
USB_GLOBAL at 0x00 — USB Controller
USB_HOST at 0x00 — USB Host Registers
BOOT_LOAD at 0x00 — Bootloader
EEPROM at 0x00
TC0 at 0x00 — Timer/Counter, 8-bit
TC2 at 0x00 — Timer/Counter, 8-bit Async
TC3 at 0x00 — Timer/Counter, 16-bit
TC1 at 0x00 — Timer/Counter, 16-bit
JTAG at 0x00 — JTAG Interface
EXINT at 0x00 — External Interrupts
ADC at 0x00 — Analog-to-Digital Converter
AC at 0x00 — Analog Comparator
PLL at 0x00 — Phase Locked Loop
FUSE at 0 in fuses — Fuses
LOCKBIT at 0 in lockbits — Lockbits

## Interrupts
0 RESET — External Pin,Power-on Reset,Brown-out Reset,Watchdog Reset,and JTAG AVR Reset. See Datasheet.
{n+1} INT{n} (n=0..7) — External Interrupt Request {n}
9 PCINT0 — Pin Change Interrupt Request 0
10 USB_GEN — USB General Interrupt Request
11 USB_COM — USB Endpoint/Pipe Interrupt Communication Request
12 WDT — Watchdog Time-out Interrupt
13 TIMER2_COMPA — Timer/Counter2 Compare Match A
14 TIMER2_COMPB — Timer/Counter2 Compare Match B
15 TIMER2_OVF — Timer/Counter2 Overflow
16 TIMER1_CAPT — Timer/Counter1 Capture Event
17 TIMER1_COMPA — Timer/Counter1 Compare Match A
18 TIMER1_COMPB — Timer/Counter1 Compare Match B
19 TIMER1_COMPC — Timer/Counter1 Compare Match C
20 TIMER1_OVF — Timer/Counter1 Overflow
21 TIMER0_COMPA — Timer/Counter0 Compare Match A
22 TIMER0_COMPB — Timer/Counter0 Compare Match B
23 TIMER0_OVF — Timer/Counter0 Overflow
24 SPI_STC — SPI Serial Transfer Complete
25 USART1_RX — USART1, Rx Complete
26 USART1_UDRE — USART1 Data register Empty
27 USART1_TX — USART1, Tx Complete
28 ANALOG_COMP — Analog Comparator
29 ADC — ADC Conversion Complete
30 EE_READY — EEPROM Ready
31 TIMER3_CAPT — Timer/Counter3 Capture Event
32 TIMER3_COMPA — Timer/Counter3 Compare Match A
33 TIMER3_COMPB — Timer/Counter3 Compare Match B
34 TIMER3_COMPC — Timer/Counter3 Compare Match C
35 TIMER3_OVF — Timer/Counter3 Overflow
36 TWI — 2-wire Serial Interface
37 SPM_READY — Store Program Memory Read

## Properties
SIGNATURES: JTAGID=0x0978203F, SIGNATURE0=0x1e, SIGNATURE1=0x97, SIGNATURE2=0x82
OCD: OCD_REVISION=3, OCD_DATAREG=0x31, PROGBASE=0x0000
