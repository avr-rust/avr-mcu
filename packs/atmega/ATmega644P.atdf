# ATmega644P device description
Architecture: AVR8; Family: megaAVR
Programming and debug interfaces: ISP, HVPP, JTAG
Registers are 8-bit, access not given, no defined reset value unless marked. A register's access mark holds for its fields unless they carry their own. Offsets are from the block's base; lines under a group give offsets from that group; [hi:lo] are bit positions; {n}, {i} and the like mark numbered series; 'fields as' and 'values as' point back to an identical list; <NAME> marks a mode.

## Ordering variants
ATmega644PV-10AU: TQFP44, pinout TQFP_VQFN_44, up to 10 MHz, -40 to 85 C, 1.8 to 5.5 V
ATmega644PV-10PU: PDIP40, up to 10 MHz, -40 to 85 C, 1.8 to 5.5 V
ATmega644PV-10MU: VQFN44, pinout TQFP_VQFN_44, up to 10 MHz, -40 to 85 C, 1.8 to 5.5 V
ATmega644P-20AU: TQFP44, pinout TQFP_VQFN_44, up to 20 MHz, -40 to 85 C, 2.7 to 5.5 V
ATmega644P-20PU: PDIP40, up to 20 MHz, -40 to 85 C, 2.7 to 5.5 V
ATmega644P-20MU: VQFN44, pinout TQFP_VQFN_44, up to 20 MHz, -40 to 85 C, 2.7 to 5.5 V
ATmega644PV-10AN: TQFP44, pinout TQFP_VQFN_44, up to 10 MHz, -40 to 105 C, 1.8 to 5.5 V
ATmega644PV-10PN: PDIP40, up to 10 MHz, -40 to 105 C, 1.8 to 5.5 V
ATmega644PV-10MN: VQFN44, pinout TQFP_VQFN_44, up to 10 MHz, -40 to 105 C, 1.8 to 5.5 V
ATmega644P-20AN: TQFP44, pinout TQFP_VQFN_44, up to 20 MHz, -40 to 105 C, 2.7 to 5.5 V
ATmega644P-20PN: PDIP40, up to 20 MHz, -40 to 105 C, 2.7 to 5.5 V
ATmega644P-20MN: VQFN44, pinout TQFP_VQFN_44, up to 20 MHz, -40 to 105 C, 2.7 to 5.5 V

## Memory
prog space: start 0x0000 size 0x10000, little endian
  0x0000 FLASH size 0x10000 flash, rw, executable, page 0x100
  0xfc00 BOOT_SECTION_1 size 0x0400 flash, rw, executable, page 0x100
  0xf800 BOOT_SECTION_2 size 0x0800 flash, rw, executable, page 0x100
  0xf000 BOOT_SECTION_3 size 0x1000 flash, rw, executable, page 0x100
  0xe000 BOOT_SECTION_4 size 0x2000 flash, rw, executable, page 0x100
signatures space: start 0 size 3, little endian
  0 SIGNATURES size 3 signatures, ro
fuses space: start 0 size 0x0003, little endian
  0 FUSES size 0x0003 fuses, rw
lockbits space: start 0 size 0x0001, little endian
  0 LOCKBITS size 0x0001 lockbits, rw
data space: start 0x0000 size 0x1100, little endian
  0x0000 REGISTERS size 0x0020 regs
  0x0020 MAPPED_IO size 0x00e0 io
  0x0100 IRAM size 0x1000 ram
eeprom space: start 0x0000 size 0x0800, little endian
  0x0000 EEPROM size 0x0800 eeprom, rw, page 0x08
io space: start 0x00 size 0x40, little endian
osccal space: start 0 size 1, little endian
  0 OSCCAL size 1 osccal, ro

## Peripheral instances (address, pins/pin function, parameters)
AC at 0x00 — Analog Comparator
  pins: AIN0 PB2; AIN1 PB3
USART0 at 0x00 — USART
  pins: TXD PD1; RXD PD0; XCK PB0
USART1 at 0x00 — USART
  pins: TXD PD3; RXD PD2; XCK PD4
PORTA at 0x00 — I/O Port
  pins: P{n} PA{n} (n=0..7)
PORTB at 0x00 — I/O Port
  pins: P{n} PB{n} (n=0..7)
PORTC at 0x00 — I/O Port
  pins: P{n} PC{n} (n=0..7)
PORTD at 0x00 — I/O Port
  pins: P{n} PD{n} (n=0..7)
TC0 at 0x00 — Timer/Counter, 8-bit
  pins: T PB0; OCB PB4; OCA PB3
TC2 at 0x00 — Timer/Counter, 8-bit Async
  pins: TOSC1 PC6; TOSC2 PC7; OCB PD6; OCA PD7
WDT at 0x00 — Watchdog Timer
JTAG at 0x00 — JTAG Interface
  pins: TCK PC2; TMS PC3; TDO PC4; TDI PC5
BOOT_LOAD at 0x00 — Bootloader
EXINT at 0x00 — External Interrupts
  pins: PCINT{n} PA{n} (n=0..7); PCINT{n} PB{n-8} (n=8..15); PCINT{n} PC{n-16} (n=16..23); PCINT{n} PD{n-24} (n=24..31); INT0 PD2; INT1 PD3; INT2 PB2
ADC at 0x00 — Analog-to-Digital Converter
  pins: ADC{n} PA{n} (n=0..7)
TC1 at 0x00 — Timer/Counter, 16-bit
  pins: T PB1; ICP PD6; OCA PD5; OCB PD4
EEPROM at 0x00
TWI at 0x00 — Two Wire Serial Interface
  pins: SDA PC1; SCL PC0
CPU at 0x00 — CPU Registers
  pins: CLKO0 PB1
  parameters: CORE_VERSION=V2E
SPI at 0x00 — Serial Peripheral Interface
  pins: SS PB4; MOSI PB5; MISO PB6; SCK PB7
FUSE at 0 in fuses — Fuses
LOCKBIT at 0 in lockbits — Lockbits

## Interrupts
0 RESET — External Pin,Power-on Reset,Brown-out Reset,Watchdog Reset,and JTAG AVR Reset. See Datasheet.
1 INT0 — External Interrupt Request 0
2 INT1 — External Interrupt Request 1
3 INT2 — External Interrupt Request 2
4 PCINT0 — Pin Change Interrupt Request 0
5 PCINT1 — Pin Change Interrupt Request 1
6 PCINT2 — Pin Change Interrupt Request 2
7 PCINT3 — Pin Change Interrupt Request 3
8 WDT — Watchdog Time-out Interrupt
9 TIMER2_COMPA — Timer/Counter2 Compare Match A
10 TIMER2_COMPB — Timer/Counter2 Compare Match B
11 TIMER2_OVF — Timer/Counter2 Overflow
12 TIMER1_CAPT — Timer/Counter1 Capture Event
13 TIMER1_COMPA — Timer/Counter1 Compare Match A
14 TIMER1_COMPB — Timer/Counter1 Compare Match B
15 TIMER1_OVF — Timer/Counter1 Overflow
16 TIMER0_COMPA — Timer/Counter0 Compare Match A
17 TIMER0_COMPB — Timer/Counter0 Compare Match B
18 TIMER0_OVF — Timer/Counter0 Overflow
19 SPI_STC — SPI Serial Transfer Complete
20 USART0_RX — USART0, Rx Complete
21 USART0_UDRE — USART0 Data register Empty
22 USART0_TX — USART0, Tx Complete
23 ANALOG_COMP — Analog Comparator
24 ADC — ADC Conversion Complete
25 EE_READY — EEPROM Ready
26 TWI — 2-wire Serial Interface
27 SPM_READY — Store Program Memory Read
28 USART1_RX — USART1 RX complete
29 USART1_UDRE — USART1 Data Register Empty
30 USART1_TX — USART1 TX complete

## Properties
SIGNATURES: JTAGID=0x0960A03f, SIGNATURE0=0x1e, SIGNATURE1=0x96, SIGNATURE2=0x0a
OCD: OCD_REVISION=3, OCD_DATAREG=0x31, PROGBASE=0x0000

## Pinouts (pin number, pad)
PDIP40: 1 PB0, 2 PB1, 3 PB2, 4 PB3, 5 PB4, 6 PB5, 7 PB6, 8 PB7, 9 RESET, 10 VCC, 11 GND, 12 XTAL2, 13 XTAL1, 14 PD0, 15 PD1, 16 PD2, 17 PD3, 18 PD4, 19 PD5, 20 PD6, 21 PD7, 22 PC0, 23 PC1, 24 PC2, 25 PC3, 26 PC4, 27 PC5, 28 PC6, 29 PC7, 30 AVCC, 31 GND, 32 AREF, 33 PA7, 34 PA6, 35 PA5, 36 PA4, 37 PA3, 38 PA2, 39 PA1, 40 PA0
TQFP_VQFN_44: 1 PB5, 2 PB6, 3 PB7, 4 RESET, 5 VCC, 6 GND, 7 XTAL2, 8 XTAL1, 9 PD0, 10 PD1, 11 PD2, 12 PD3, 13 PD4, 14 PD5, 15 PD6, 16 PD7, 17 VCC, 18 GND, 19 PC0, 20 PC1, 21 PC2, 22 PC3, 23 PC4, 24 PC5, 25 PC6, 26 PC7, 27 AVCC, 28 GND, 29 REF, 30 PA7, 31 PA6, 32 PA5, 33 PA4, 34 PA3, 35 PA2, 36 PA1, 37 PA0, 38 VCC, 39 GND, 40 PB0, 41 PB1, 42 PB2, 43 PB3, 44 PB4
