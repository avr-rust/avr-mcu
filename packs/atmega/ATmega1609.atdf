# ATmega1609 device description
Architecture: AVR8X; Family: AVR MEGA
Programming and debug interfaces: UPDI
Registers are 8-bit, read-write, reset 0x0 unless marked. A register's access mark holds for its fields unless they carry their own. Offsets are from the block's base; lines under a group give offsets from that group; [hi:lo] are bit positions; {n}, {i} and the like mark numbered series; 'fields as' and 'values as' point back to an identical list; <NAME> marks a mode.

## Ordering variants
ATmega1609-AFR: TQFP48, pinout QFP48, up to 20 MHz, -40 to 105 C, 1.8 to 5.0 V
ATmega1609-MFR: UQFN48, pinout QFN48, up to 20 MHz, -40 to 105 C, 1.8 to 5.0 V

## Memory
data space: start 0x0000 size 0x4000, little endian
  0x00001400 EEPROM size 0x0100 eeprom, rw, page 0x20
  0x00001280 FUSES size 0xA fuses, rw, page 0x20
  0x3800 INTERNAL_SRAM size 0x0800 ram, rw
  0x00000000 IO size 0x1100 io, rw
  0x0000128A LOCKBITS size 0x1 lockbits, rw, page 0x20
  0x00004000 MAPPED_PROGMEM size 0x4000 other, ro, page 0x40
  0x00001103 PROD_SIGNATURES size 0x3D signatures, ro, page 0x40
  0x00001100 SIGNATURES size 0x3 signatures, ro, page 0x40
  0x00001300 USER_SIGNATURES size 0x20 user_signatures, rw, page 0x20
prog space: start 0x0000 size 0x4000, little endian
  0x00000000 PROGMEM size 0x4000 flash, rw, executable, page 0x40

## Peripheral instances (address, pins/pin function, parameters)
AC0 at 0x0680 (AC)
  pins: N0 PD3; N1 PD5; N2 PD7; OUT0 PA7; P0 PD2; P1 PD4; P2 PD6; P3 PD1
ADC0 at 0x0600 (ADC)
  pins: AIN{n} PD{n}/AIN0 (n=0..7); AIN8 PE0/AIN0; AIN9 PE1/AIN0; AIN10 PE2/AIN0; AIN11 PE3/AIN0; AIN12 PF2/AIN0; AIN13 PF3/AIN0; AIN14 PF4/AIN0; AIN15 PF5/AIN0
BOD at 0x0080
CCL at 0x01C0
  pins: LUT0_IN0 PA0; LUT0_IN1 PA1; LUT0_IN2 PA2; LUT0_OUT0 PA6/CCL_ALT or PA3; LUT1_IN0 PC0; LUT1_IN1 PC1; LUT1_IN2 PC2; LUT1_OUT0 PC6/CCL_ALT or PC3; LUT2_IN0 PD0; LUT2_IN1 PD1; LUT2_IN2 PD2; LUT2_OUT0 PD3; LUT2_OUT1 PD6/CCL_ALT; LUT3_IN0 PF0; LUT3_IN1 PF1; LUT3_IN2 PF2; LUT3_OUT1 PF6/CCL_ALT or PF3
  pin routing set by: PORTMUX.CCLROUTEA.LUT0, PORTMUX.CCLROUTEA.LUT1, PORTMUX.CCLROUTEA.LUT2, PORTMUX.CCLROUTEA.LUT3
CLKCTRL at 0x0060
  pins: CLKI PA0; CLKO PA7; TOSC1 PF0; TOSC2 PF1
CPU at 0x0030
  parameters: CORE_VERSION=V4
CPUINT at 0x0110
CRCSCAN at 0x0120
EVSYS at 0x0180
  pins: EVOUT0 PA7/EVSYS_ALT or PA2; EVOUT1 PB2; EVOUT2 PC7/EVSYS_ALT or PC2; EVOUT3 PD7/EVSYS_ALT or PD2; EVOUT4 PE2; EVOUT5 PF2
  pin routing set by: PORTMUX.EVSYSROUTEA.EVOUT0, PORTMUX.EVSYSROUTEA.EVOUT1, PORTMUX.EVSYSROUTEA.EVOUT2, PORTMUX.EVSYSROUTEA.EVOUT3, PORTMUX.EVSYSROUTEA.EVOUT4, PORTMUX.EVSYSROUTEA.EVOUT5
FUSE at 0x1280
GPIO at 0x001C
LOCKBIT at 0x128A
NVMCTRL at 0x1000
PORTA at 0x0400 (PORT)
  pins: PIN{n} PA{n}/IOPORT (n=0..7)
PORTB at 0x0420 (PORT)
  pins: PIN0 PB0/IOPORT; PIN1 PB1/IOPORT; PIN2 PB2/IOPORT; PIN3 PB3/IOPORT; PIN4 PB4/IOPORT; PIN5 PB5/IOPORT
PORTC at 0x0440 (PORT)
  pins: PIN{n} PC{n}/IOPORT (n=0..7)
PORTD at 0x0460 (PORT)
  pins: PIN{n} PD{n}/IOPORT (n=0..7)
PORTE at 0x0480 (PORT)
  pins: PIN0 PE0/IOPORT; PIN1 PE1/IOPORT; PIN2 PE2/IOPORT; PIN3 PE3/IOPORT
PORTF at 0x04A0 (PORT)
  pins: PIN0 PF0/IOPORT; PIN1 PF1/IOPORT; PIN2 PF2/IOPORT; PIN3 PF3/IOPORT; PIN4 PF4/IOPORT; PIN5 PF5/IOPORT; PIN6 PF6/IOPORT
PORTMUX at 0x05E0
RSTCTRL at 0x0040
  pins: RESET PF6/OTHER
RTC at 0x0140
SIGROW at 0x1100
SLPCTRL at 0x0050
SPI0 at 0x08C0 (SPI)
  pins: MISO PE1/SPI_ALT2 or PC1/SPI_ALT or PA5; MOSI PE0/SPI_ALT2 or PC0/SPI_ALT or PA4; SCK PE2/SPI_ALT2 or PC2/SPI_ALT or PA6; SS PE3/SPI_ALT2 or PC3/SPI_ALT or PA7
  pin routing set by: PORTMUX.TWISPIROUTEA.SPI0
SYSCFG at 0x0F00
TCA0 at 0x0A00 (TCA)
  pins: WO0 PF0/TCA_ALT5 or PE0/TCA_ALT4 or PD0/TCA_ALT3 or PC0/TCA_ALT2 or PB0/TCA_ALT or PA0; WO1 PF1/TCA_ALT5 or PE1/TCA_ALT4 or PD1/TCA_ALT3 or PC1/TCA_ALT2 or PB1/TCA_ALT or PA1; WO2 PF2/TCA_ALT5 or PE2/TCA_ALT4 or PD2/TCA_ALT3 or PC2/TCA_ALT2 or PB2/TCA_ALT or PA2; WO3 PF3/TCA_ALT5 or PE3/TCA_ALT4 or PD3/TCA_ALT3 or PC3/TCA_ALT2 or PB3/TCA_ALT or PA3; WO4 PF4/TCA_ALT5 or PD4/TCA_ALT3 or PC4/TCA_ALT2 or PB4/TCA_ALT or PA4; WO5 PF5/TCA_ALT5 or PD5/TCA_ALT3 or PC5/TCA_ALT2 or PB5/TCA_ALT or PA5
  pin routing set by: PORTMUX.TCAROUTEA.TCA0
TCB0 at 0x0A80 (TCB)
  pins: WO0 PF4/TCB0_ALT or PA2
  pin routing set by: PORTMUX.TCBROUTEA.TCB0
TCB1 at 0x0A90 (TCB)
  pins: WO0 PF5/TCB1_ALT or PA3
  pin routing set by: PORTMUX.TCBROUTEA.TCB1
TCB2 at 0x0AA0 (TCB)
  pins: WO0 PB4/TCB2_ALT or PC0
  pin routing set by: PORTMUX.TCBROUTEA.TCB2
TCB3 at 0x0AB0 (TCB)
  pins: WO0 PC1/TCB3_ALT or PB5
  pin routing set by: PORTMUX.TCBROUTEA.TCB3
TWI0 at 0x08A0 (TWI)
  pins: SCL PF3/I2C_ALT2 or PC3/I2C_ALT or PA3/I2C; SDA PF2/I2C_ALT2 or PC2/I2C_ALT or PA2/I2C
  pin routing set by: PORTMUX.TWISPIROUTEA.TWI0
USART0 at 0x0800 (USART)
  pins: RXD PA5/USART0_ALT or PA1; TXD PA4/USART0_ALT or PA0; XCK PA6/USART0_ALT or PA2; XDIR PA7/USART0_ALT or PA3
  pin routing set by: PORTMUX.USARTROUTEA.USART0
USART1 at 0x0820 (USART)
  pins: RXD PC5/USART1_ALT or PC1; TXD PC4/USART1_ALT or PC0; XCK PC6/USART1_ALT or PC2; XDIR PC7/USART1_ALT or PC3
  pin routing set by: PORTMUX.USARTROUTEA.USART1
USART2 at 0x0840 (USART)
  pins: RXD PF5/USART2_ALT or PF1; TXD PF4/USART2_ALT or PF0; XCK PF6/USART2_ALT or PF2; XDIR PF3
  pin routing set by: PORTMUX.USARTROUTEA.USART2
USART3 at 0x0860 (USART)
  pins: RXD PB5/USART3_ALT or PB1; TXD PB4/USART3_ALT or PB0; XCK PB2; XDIR PB3
  pin routing set by: PORTMUX.USARTROUTEA.USART3
USERROW at 0x1300
VPORTA at 0x0000 (VPORT)
VPORTB at 0x0004 (VPORT)
VPORTC at 0x0008 (VPORT)
VPORTD at 0x000C (VPORT)
VPORTE at 0x0010 (VPORT)
VPORTF at 0x0014 (VPORT)
VREF at 0x00A0
WDT at 0x0100

## Interrupts
1 NMI (CRCSCAN)
2 VLM (BOD)
3 CNT (RTC)
4 PIT (RTC)
5 CCL
6 PORT (PORTA)
7 LUNF (TCA0)
7 OVF (TCA0)
8 HUNF (TCA0)
9 CMP0 (TCA0)
9 LCMP0 (TCA0)
10 CMP1 (TCA0)
10 LCMP1 (TCA0)
11 CMP2 (TCA0)
11 LCMP2 (TCA0)
12 INT (TCB0)
13 INT (TCB1)
14 TWIS (TWI0)
15 TWIM (TWI0)
16 INT (SPI0)
17 RXC (USART0)
18 DRE (USART0)
19 TXC (USART0)
20 PORT (PORTD)
21 AC (AC0)
22 RESRDY (ADC0)
23 WCOMP (ADC0)
24 PORT (PORTC)
25 INT (TCB2)
26 RXC (USART1)
27 DRE (USART1)
28 TXC (USART1)
29 PORT (PORTF)
30 EE (NVMCTRL)
31 RXC (USART2)
32 DRE (USART2)
33 TXC (USART2)
34 PORT (PORTB)
35 PORT (PORTE)
36 INT (TCB3)
37 RXC (USART3)
38 DRE (USART3)
39 TXC (USART3)

## Properties
OCD_FEATURES: BREAK_PIN=PF6, BREAK_PIN_ALT=PF2
SIGNATURES: SIGNATURE0=0x1E, SIGNATURE1=0x94, SIGNATURE2=0x26

## Pinouts (pin number, pad)
QFN48, QFP48: 1 PA5, 2 PA6, 3 PA7, 4 PB0, 5 PB1, 6 PB2, 7 PB3, 8 PB4, 9 PB5, 10 PC0, 11 PC1, 12 PC2, 13 PC3, 14 VDD0, 15 GND0, 16 PC4, 17 PC5, 18 PC6, 19 PC7, 20 PD0, 21 PD1, 22 PD2, 23 PD3, 24 PD4, 25 PD5, 26 PD6, 27 PD7, 28 AVDD, 29 AGND, 30 PE0, 31 PE1, 32 PE2, 33 PE3, 34 PF0, 35 PF1, 36 PF2, 37 PF3, 38 PF4, 39 PF5, 40 PF6, 41 UPDI, 42 VDD1, 43 GND1, 44 PA0, 45 PA1, 46 PA2, 47 PA3, 48 PA4
